.include "m32def.inc"
.ORG 0
		RJMP	START

.ORG	OC1Aaddr
		RJMP	ROUTINE_INTERRUPTR_1	
START:
		LDI		R16,HIGH(RAMEND)		;Initialize SP
		OUT		SPH,R16
		LDI		R16,LOW(RAMEND)
		OUT		SPL,R16

; Initialize Timer/Counter 1
		LDI		R16,HIGH(2000)
		OUT		OCR1AH,R16
		LDI		R16,LOW(2000)
		OUT		OCR1AL,R16
		LDI		R16,0b00001101
		OUT		TCCR1B,R16
		LDI		R16,0b00000000
		OUT		TCCR1A,R16

		LDI		R16,0b00010000
		OUT		TIMSK,R16
		SEI		

		LDI		R16,0xFF
		OUT		DDRB,R16
		LDI		R16,0xFF
		OUT		DDRD,R16
		LDI		R16,1
BEGIN:	OUT		PORTB,R16
		RJMP	BEGIN



ROUTINE_INTERRUPTR_1:
		LSL		R16
		OUT		PORTB,R16
		CPI		R16,0
		BRNE	C1
		LDI		R16,01
C1:		RETI